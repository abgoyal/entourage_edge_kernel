## arch/arm/mach-mmp/Kconfig
```kconfig
if ARCH_MMP

menu "Marvell PXA168 Implmentations"

config MACH_ASPENITE
	bool "Marvell's PXA168 Aspenite Development Board"
	select CPU_PXA168
	help
	  Say 'Y' here if you want to support the Marvell PXA168-based
	  Aspenite Development Board.

config MACH_ZYLONITE2
	bool "Marvell's PXA168 Zylonite2 Development Board"
	select CPU_PXA168
	help
	  Say 'Y' here if you want to support the Marvell PXA168-based
	  Zylonite2 Development Board.

config MACH_IPCAM
	bool "Marvell's PXA168 IPCAM Development Board"
	select CPU_PXA168
	help
	  Say 'Y' here if you want to support the Marvell PXA168-based
	  IPCAM Development Board.

config MACH_DKB_GENERIC
	bool "Marvell's PXA910 Generic DKB Development Board"
	select CPU_PXA910
	select CPU_PXA168
	help
	  Say 'Y' here if you want to support the Marvell PXA910-based
	  DKB Development Board.


config MACH_TTC_DKB
	bool "Marvell's PXA910 TTC_DKB Development Board"
	select CPU_PXA910
	select CPU_PXA168
	help
	  Say 'Y' here if you want to support the Marvell PXA910-based
	  TTC_DKB Development Board.

config MACH_TAVOREVB
	bool "PXA910 Evaluation Board (aka TavorEVB)"
	select CPU_PXA910
	select CPU_PXA168
	help
	  Say 'Y' here if you want to support the Marvell PXA910-based
	  TavorEVB Development Board.

config MACH_AVENGERS_LITE
	bool "Marvell's PXA168 Avengers lite Development Board"
	select CPU_PXA168
	select HAVE_PWM
	help
	  Say 'Y' here if you want to support the Marvell PXA168-based
	  Avengers lite Development Board.

config MACH_EDGE
	bool "Marvell's PXA168 Edge 2.0 Development Board"
	select CPU_PXA168
	select HAVE_PWM
	help
	  Say 'Y' here if you want to support the Marvell PXA168-based
	  Edge Development Board.

comment "Start of ESI Additions"
config ESI_EDGE
	bool "ESI edge support"
	depends on MACH_EDGE
	help
	  This enables ESI-specific functionality on eDGe 2.0 hardware.

config ESI_EDGE_JR
	bool "ESI edge junior support"
	depends on MACH_EDGE && ESI_EDGE
	help
	  This enables ESI-specific functionality on eDGe Jr. hardware.

endmenu

config GLOBAL_PREEMPT_NOTIFIERS
	bool "Enable global preempt notifier"
	depends on PREEMPT_NOTIFIERS
	default y

config CPU_PXA168
	bool
	select CPU_MOHAWK
	select PREEMPT_NOTIFIERS
	help
	  Select code specific to PXA168

config CPU_PXA910
	bool
	select CPU_MOHAWK
	select PREEMPT_NOTIFIERS
	help
	  Select code specific to PXA910

config PXA_32KTIMER
	bool "PXA 32K OS Timer"
	help
	  enable 32KHz OS timer for PXA168/PXA910 Processor

endif
```
